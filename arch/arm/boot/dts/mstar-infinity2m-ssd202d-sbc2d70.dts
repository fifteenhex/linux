// SPDX-License-Identifier: GPL-2.0-or-later
/*
 * Copyright (c) 2020 thingy.jp.
 * Author: Daniel Palmer <daniel@thingy.jp>
 */

/dts-v1/;
#include "mstar-infinity2m-ssd202d-som2d01.dts"

/ {
	model = "SBC2D70 (SSD202D)";
	compatible = "ido,sbc2d70", "mstar,infinity2m";
};
