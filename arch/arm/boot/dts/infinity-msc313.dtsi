// SPDX-License-Identifier: GPL-2.0
/*
 * Copyright (c) 2019 thingy.jp.
 * Author: Daniel Palmer <daniel@thingy.jp>
 */

#include "infinity.dtsi"
/{
};

&pinctrl {
	compatible = "mstar,msc313-pinctrl";
};

&gpio_pm {
	gpio-ranges = <&pinctrl 0 21 1>, <&pinctrl 1 15 1>;
};
