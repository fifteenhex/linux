## Documentation/devicetree/bindings/media/cnm,wave521c.yaml
```yaml
# SPDX-License-Identifier: (GPL-2.0 OR BSD-2-Clause)
%YAML 1.2
---
$id: http://devicetree.org/schemas/media/cnm,wave521c.yaml#
$schema: http://devicetree.org/meta-schemas/core.yaml#

title: Chips&Media Wave 5 Series multi-standard codec IP

maintainers:
  - Nas Chung <nas.chung@chipsnmedia.com>
  - Jackson Lee <jackson.lee@chipsnmedia.com>

description:
  The Chips&Media WAVE codec IP is a multi format video encoder/decoder

properties:
  compatible:
    oneOf:
      - items:
          - enum:
              - ti,j721s2-wave521c
          - const: cnm,wave521c
      - items:
          - const: sstar,ssd20xd-vdec
          - const: cnm,wave511

  reg:
    minItems: 1
    items:
      - description: VPU registers
      - description: SoC wrapper around the VPU, which gates its interrupt

  reg-names:
    minItems: 1
    items:
      - const: vpu
      - const: wrapper

  clocks:
    minItems: 1
    maxItems: 4

  clock-names:
    minItems: 1
    maxItems: 4

  interrupts:
    maxItems: 1

  power-domains:
    maxItems: 1

  resets:
    maxItems: 1

  sram:
    maxItems: 1
    description:
      The VPU uses the SRAM to store some of the reference data instead of
      storing it on DMA memory. It is mainly used for the purpose of reducing
      bandwidth.

required:
  - compatible
  - reg
  - clocks

allOf:
  - if:
      properties:
        compatible:
          contains:
            const: sstar,ssd20xd-vdec
    then:
      properties:
        reg:
          minItems: 2
        reg-names:
          minItems: 2
        clocks:
          minItems: 4
          items:
            - description: APB clock
            - description: AXI clock
            - description: BPU clock
            - description: VCE clock
    else:
      properties:
        reg:
          maxItems: 1
        reg-names:
          maxItems: 1
        clocks:
          items:
            - description: VCODEC clock

additionalProperties: false

examples:
  - |
    vpu: video-codec@12345678 {
        compatible = "ti,j721s2-wave521c", "cnm,wave521c";
        reg = <0x12345678 0x1000>;
        clocks = <&clks 42>;
        interrupts = <42>;
        sram = <&sram>;
    };
```

## Documentation/devicetree/bindings/sound/mstar,msc313-bach.yaml
```yaml
# SPDX-License-Identifier: (GPL-2.0-only OR BSD-2-Clause)
%YAML 1.2
---
$id: http://devicetree.org/schemas/sound/mstar,msc313-bach.yaml#
$schema: http://devicetree.org/meta-schemas/core.yaml#

title: MStar/SigmaStar BACH audio

maintainers:
  - Daniel Palmer <daniel@thingy.jp>

description:
  The BACH block is the on-chip audio of the MStar/SigmaStar ARMv7 SoCs. It
  holds the DMA reader and writer that feed and drain the codec, the digital
  gain stages and the I2S interface; the analog side (DACs, ADCs, mic and
  line inputs) sits in the audio top block and is controlled through a
  syscon. The driver presents the whole thing as one sound card, so the
  board's speaker amplifier and headphone jack are described here too.

properties:
  compatible:
    enum:
      - mstar,msc313-bach
      - mstar,ssd210-bach

  reg:
    maxItems: 1

  clocks:
    maxItems: 1

  interrupts:
    maxItems: 1

  mstar,audiotop:
    $ref: /schemas/types.yaml#/definitions/phandle
    description: The audio top syscon with the analog controls.

  interconnects:
    maxItems: 1

  interconnect-names:
    const: dma-mem

  amp-gpios:
    maxItems: 1
    description:
      Enable of the speaker amplifier fed from the line output, driven
      while the speaker is in use.

  hp-det-gpios:
    maxItems: 1
    description:
      Headphone jack detection. While headphones are plugged the speaker
      is switched off.

  audio-aux-devs:
    $ref: /schemas/types.yaml#/definitions/phandle-array
    description: Auxiliary devices for the card, as for simple-audio-card.

required:
  - compatible
  - reg
  - clocks
  - interrupts
  - mstar,audiotop

additionalProperties: false

examples:
  - |
    #include <dt-bindings/gpio/gpio.h>
    #include <dt-bindings/interrupt-controller/arm-gic.h>
    #include <dt-bindings/interrupt-controller/irq.h>

    bach: bach@2a0400 {
        compatible = "mstar,msc313-bach";
        reg = <0x2a0400 0x600>;
        clocks = <&clkgen 0>;
        interrupts = <GIC_SPI 42 IRQ_TYPE_LEVEL_HIGH>;
        mstar,audiotop = <&audiotop>;
        amp-gpios = <&gpio 0 GPIO_ACTIVE_HIGH>;
    };
```

## arch/m68k/Kconfig
```kconfig
# SPDX-License-Identifier: GPL-2.0
config M68K
	bool
	default y
	select ARCH_32BIT_OFF_T
	select ARCH_HAS_BINFMT_FLAT
	select ARCH_HAS_CPU_CACHE_ALIASING
	select ARCH_HAS_CPU_FINALIZE_INIT if MMU
	select ARCH_HAS_CURRENT_STACK_POINTER
	select ARCH_HAS_DMA_PREP_COHERENT if M68K_NONCOHERENT_DMA && !COLDFIRE
	select ARCH_HAS_SYNC_DMA_FOR_DEVICE if M68K_NONCOHERENT_DMA
	select ARCH_HAVE_NMI_SAFE_CMPXCHG if RMW_INSNS
	select ARCH_MIGHT_HAVE_PC_PARPORT if ISA
	select ARCH_NO_PREEMPT if !COLDFIRE
	select ARCH_USE_MEMTEST if MMU_MOTOROLA
	select ARCH_WANT_IPC_PARSE_VERSION
	select BINFMT_FLAT_ARGVP_ENVP_ON_STACK
	select DMA_DIRECT_REMAP if M68K_NONCOHERENT_DMA && !COLDFIRE
	select GENERIC_ATOMIC64
	select GENERIC_CPU_DEVICES
	select GENERIC_IOMAP if HAS_IOPORT && MMU && !COLDFIRE
	select GENERIC_IRQ_SHOW
	select GENERIC_LIB_ASHLDI3
	select GENERIC_LIB_ASHRDI3
	select GENERIC_LIB_LSHRDI3
	select GENERIC_LIB_MULDI3
	select GENERIC_PCI_IOMAP if PCI
	select HAS_IOPORT if PCI || ISA || ATARI_ROM_ISA
	select HAVE_ARCH_LIBGCC_H
	select HAVE_ARCH_SECCOMP
	select HAVE_ARCH_SECCOMP_FILTER
	select HAVE_ASM_MODVERSIONS
	select HAVE_DEBUG_BUGVERBOSE
	select HAVE_EFFICIENT_UNALIGNED_ACCESS if !CPU_HAS_NO_UNALIGNED
	select HAVE_LD_DEAD_CODE_DATA_ELIMINATION
	select HAVE_MOD_ARCH_SPECIFIC
	select HAVE_UID16
	select MMU_GATHER_NO_RANGE if MMU
	select MODULES_USE_ELF_REL
	select MODULES_USE_ELF_RELA
	select NO_DMA if !MMU && !COLDFIRE
	select OLD_SIGACTION
	select OLD_SIGSUSPEND3
	select UACCESS_MEMCPY if !MMU
	select ZONE_DMA
	select HOTPLUG_CORE_SYNC_DEAD if HOTPLUG_CPU

config CPU_BIG_ENDIAN
	def_bool y

config ARCH_HAS_ILOG2_U32
	bool

config ARCH_HAS_ILOG2_U64
	bool

config GENERIC_HWEIGHT
	bool
	default y

config GENERIC_CALIBRATE_DELAY
	bool
	default y

config GENERIC_CSUM
	bool

config TIME_LOW_RES
	bool
	default y

config NO_IOPORT_MAP
	def_bool y

config HZ
	int
	default 1000 if CLEOPATRA
	default 100

config PGTABLE_LEVELS
	default 2 if SUN3 || COLDFIRE
	default 3

config MMU
	bool "MMU-based Paged Memory Management Support"
	default y
	help
	  Select if you want MMU-based virtualised addressing space
	  support by paged memory management. If unsure, say 'Y'.

config MMU_MOTOROLA
	def_bool MMU && M68KCLASSIC
	select HAVE_PAGE_SIZE_4KB

config MMU_COLDFIRE
	def_bool MMU && COLDFIRE
	select HAVE_PAGE_SIZE_8KB

config MMU_SUN3
	def_bool MMU && SUN3
	select HAVE_PAGE_SIZE_8KB

config ARCH_SUPPORTS_KEXEC
	def_bool (M68KCLASSIC || SUN3) && MMU

config BOOTINFO_PROC
	bool "Export bootinfo in procfs"
	depends on KEXEC && (M68KCLASSIC || SUN3)
	help
	  Say Y to export the bootinfo used to boot the kernel in a
	  "bootinfo" file in procfs.  This is useful with kexec.

menu "Platform setup"

source "arch/m68k/Kconfig.cpu"

source "arch/m68k/Kconfig.machine"

source "arch/m68k/Kconfig.bus"

endmenu

menu "Kernel Features"

config SMP
	bool "Symmetric multi-processing support"
	depends on MMU && (M68040 || M68060) && !COLDFIRE && !SUN3
	select GENERIC_SMP_IDLE_THREAD
	# SMP needs native cas atomics / ticket spinlocks.
	select RMW_INSNS
	# generic-y spinlock.h pulls in the asm-generic qrwlock, whose slowpaths
	# (queued_{read,write}_lock_slowpath) only build under this symbol.
	select ARCH_USE_QUEUED_RWLOCKS
	# NB: do NOT select GENERIC_IRQ_MULTI_HANDLER.  m68k dispatches interrupts
	# through the per-CPU 680x0 vector table (m68k_setup_{auto,user}_interrupt
	# -> do_IRQ); it never registers a single root handle_arch_irq().  Selecting
	# the multi-handler routes IRQs to a NULL handle_arch_irq and the first timer
	# tick after init_IRQ hangs the boot.  Each CPU has its own VBR, so per-CPU
	# IRQ delivery already works without it.
	help
	  Support for multiple 68040/68060 CPUs.  This is the generic m68k SMP
	  core; each board must also provide the bring-up glue (secondary release,
	  the IPI doorbells, a per-CPU tick and cache/bus coherency) -- see the
	  reference implementation in arch/m68k/eltec/smp_e17.c and the porting
	  guide in arch/m68k/SMP-PORTING.rst.

	  If your m68k machine has a single CPU, or you have not written the board
	  bring-up glue yet, say N.  If unsure, say N.

config NR_CPUS
	int "Maximum number of CPUs" if SMP
	depends on SMP
	default "2"
	help
	  The maximum number of CPUs the kernel can support.  Set this to the
	  number of CPU sockets fitted to your board.

config HOTPLUG_CPU
	bool "Support for hot-pluggable CPUs"
	depends on SMP
	select GENERIC_IRQ_MIGRATION
	help
	  Allow secondary CPUs to be brought online/offline at runtime via
	  /sys/devices/system/cpu/cpuN/online.  Very useful for bring-up: boot
	  with "maxcpus=1" to a shell, then online CPU1 with the console and dmesg
	  available.  If unsure, say Y.

endmenu

if !MMU
menu "Power management options"

config PM
	bool "Power Management support"
	help
	  Support processor power management modes

endmenu
endif

source "arch/m68k/Kconfig.devices"
```

## arch/m68k/configs/megadrive_defconfig
```kconfig
CONFIG_LOG_BUF_SHIFT=12
CONFIG_CC_OPTIMIZE_FOR_SIZE=y
CONFIG_LD_DEAD_CODE_DATA_ELIMINATION=y
CONFIG_EXPERT=y
# CONFIG_UID16 is not set
# CONFIG_SGETMASK_SYSCALL is not set
# CONFIG_FHANDLE is not set
# CONFIG_POSIX_TIMERS is not set
CONFIG_BASE_SMALL=y
# CONFIG_FUTEX is not set
# CONFIG_EPOLL is not set
# CONFIG_SIGNALFD is not set
# CONFIG_TIMERFD is not set
# CONFIG_EVENTFD is not set
# CONFIG_AIO is not set
# CONFIG_IO_URING is not set
# CONFIG_ADVISE_SYSCALLS is not set
# CONFIG_MEMBARRIER is not set
# CONFIG_CACHESTAT_SYSCALL is not set
# CONFIG_KALLSYMS is not set
# CONFIG_MMU is not set
CONFIG_M68KCLASSIC=y
CONFIG_M68KDT=y
# CONFIG_M68KDT_VIRT is not set
CONFIG_M68KDT_MEGADRIVE=y
# CONFIG_SECCOMP is not set
# CONFIG_COMPAT_32BIT_TIME is not set
# CONFIG_BLOCK_LEGACY_AUTOLOAD is not set
# CONFIG_BLK_DEV_WRITE_MOUNTED is not set
CONFIG_PARTITION_ADVANCED=y
# CONFIG_MSDOS_PARTITION is not set
# CONFIG_EFI_PARTITION is not set
# CONFIG_MQ_IOSCHED_DEADLINE is not set
# CONFIG_MQ_IOSCHED_KYBER is not set
# CONFIG_BINFMT_SCRIPT is not set
# CONFIG_COREDUMP is not set
CONFIG_SLUB_TINY=y
# CONFIG_VM_EVENT_COUNTERS is not set
CONFIG_MEMFD_CREATE=y
CONFIG_DEVTMPFS=y
CONFIG_DEVTMPFS_MOUNT=y
# CONFIG_FW_LOADER is not set
# CONFIG_ALLOW_DEV_COREDUMP is not set
CONFIG_OF_COMPATIBLE_MAX_LEN=64
# CONFIG_OF_NAME_TYPE is not set
# CONFIG_INPUT is not set
# CONFIG_SERIO is not set
# CONFIG_VT is not set
# CONFIG_UNIX98_PTYS is not set
# CONFIG_LEGACY_PTYS is not set
# CONFIG_LEGACY_TIOCSTI is not set
# CONFIG_LDISC_AUTOLOAD is not set
CONFIG_VDP_TTY=y
CONFIG_EVERDRIVE_TTY=y
# CONFIG_HW_RANDOM is not set
# CONFIG_HWMON is not set
# CONFIG_USB_SUPPORT is not set
CONFIG_RTC_CLASS=y
# CONFIG_RTC_SYSTOHC is not set
# CONFIG_RTC_NVMEM is not set
# CONFIG_RTC_INTF_PROC is not set
# CONFIG_VIRTIO_MENU is not set
# CONFIG_VHOST_MENU is not set
# CONFIG_FILE_LOCKING is not set
# CONFIG_DNOTIFY is not set
# CONFIG_INOTIFY_USER is not set
# CONFIG_PROC_SYSCTL is not set
CONFIG_EROFS_FS=y
CONFIG_EROFS_FS_DEBUG=y
# CONFIG_EROFS_FS_XATTR is not set
# CONFIG_EROFS_FS_BACKED_BY_FILE is not set
# CONFIG_EROFS_FS_ZIP_LZMA is not set
CONFIG_PROC_MEM_NO_FORCE=y
# CONFIG_CRC_OPTIMIZATIONS is not set
# CONFIG_SYMBOLIC_ERRNAME is not set
# CONFIG_DEBUG_BUGVERBOSE is not set
# CONFIG_DEBUG_MISC is not set
CONFIG_DEBUG_INFO_DWARF_TOOLCHAIN_DEFAULT=y
CONFIG_FRAME_WARN=1024
# CONFIG_SECTION_MISMATCH_WARN_ONLY is not set
CONFIG_FRAME_POINTER=y
CONFIG_FULLDEBUG=y
# CONFIG_RUNTIME_TESTING_MENU is not set
```

## drivers/media/platform/mstar/Kconfig
```kconfig
config VIDEO_MSTAR_VIF
	tristate "MStar VIF"
	depends on VIDEO_V4L2 && COMMON_CLK && VIDEO_V4L2_SUBDEV_API && HAS_DMA
	depends on ARCH_MSTAR || COMPILE_TEST
	help
	  xx

config VIDEO_MSTAR_DIP
	tristate "SigmaStar SSD20xD DIP image processor"
	depends on V4L_MEM2MEM_DRIVERS
	depends on VIDEO_DEV && COMMON_CLK && HAS_DMA
	depends on ARCH_MSTARV7 || COMPILE_TEST
	select VIDEOBUF2_DMA_CONTIG
	select V4L2_MEM2MEM_DEV
	help
	  A memory to memory video processor: it converts between NV12, packed
	  YUV422, RGB565 and ARGB8888, mirrors horizontally, scales and crops.
	  The useful thing about it on this SoC is that it is the only block that
	  reads the video decoder's NV12 and writes something the 2D engine can
	  rotate.
```
