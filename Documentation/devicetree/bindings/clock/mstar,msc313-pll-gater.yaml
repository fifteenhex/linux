## Documentation/devicetree/bindings/clock/mstar,msc313-pll-gater.yaml
```yaml
# SPDX-License-Identifier: (GPL-2.0 OR BSD-2-Clause)
%YAML 1.2
---
$id: http://devicetree.org/schemas/clock/mstar,msc313-pll-gater.yaml#
$schema: http://devicetree.org/meta-schemas/core.yaml#

title: MStar/Sigmastar MSC313 PLL gater

maintainers:
  - Daniel Palmer <daniel@thingy.jp>

description: |
  The MStar/Sgimastar MSC313 and later ARMv7 chips have a set of gates that
  collects the outputs from on-chip PLLs before feeding them to some dividers
  and then muxes for the various peripherals.

select: false

properties:
  compatible:
    const: mstar,msc313-pll-gater

  "#clock-cells":
    const: 1

  clocks: true

  clock-names: true

required:
  - compatible
  - "#clock-cells"
  - clocks
  - clock-names

additionalProperties: false
```

## Documentation/devicetree/bindings/gpio/mstar,msc313-gpio.yaml
```yaml
# SPDX-License-Identifier: GPL-2.0-only OR BSD-2-Clause
%YAML 1.2
---
$id: http://devicetree.org/schemas/gpio/mstar,msc313-gpio.yaml#
$schema: http://devicetree.org/meta-schemas/core.yaml#

title: MStar/SigmaStar GPIO controller

maintainers:
  - Daniel Palmer <daniel@thingy.jp>

properties:
  $nodename:
    pattern: "^gpio@[0-9a-f]+$"

  compatible:
    const: mstar,msc313-gpio

  reg:
    maxItems: 1

  gpio-controller: true

  "#gpio-cells":
    const: 2

  gpio-ranges: true

  gpio-ranges-group-names:
    $ref: /schemas/types.yaml#/definitions/string-array

  interrupts: true

  interrupt-names:
    description: |
      The interrupt name should match the pin that the interrupt
      is connected to.

required:
  - compatible
  - reg
  - gpio-controller
  - "#gpio-cells"

examples:
  - |
    #include <dt-bindings/interrupt-controller/irq.h>
    #include <dt-bindings/interrupt-controller/arm-gic.h>
    #include <dt-bindings/gpio/msc313-gpio.h>

    gpio: gpio@207800 {
      compatible = "mstar,msc313e-gpio";
      #gpio-cells = <2>;
      reg = <0x207800 0x200>;
      gpio-controller;
      gpio-ranges = <&pinctrl 0 36 22>,
                    <&pinctrl 22 63 4>,
                    <&pinctrl 26 68 6>;
      interrupt-parent = <&intc_fiq>;
      interrupt-names = MSC313_PINNAME_SPI0_CZ,
                        MSC313_PINNAME_SPI0_CK,
                        MSC313_PINNAME_SPI0_DI,
                        MSC313_PINNAME_SPI0_DO;
      interrupts = <GIC_SPI 28 IRQ_TYPE_LEVEL_HIGH>,
                   <GIC_SPI 29 IRQ_TYPE_LEVEL_HIGH>,
                   <GIC_SPI 30 IRQ_TYPE_LEVEL_HIGH>,
                   <GIC_SPI 31 IRQ_TYPE_LEVEL_HIGH>;
      status = "okay";
    };
```

## Documentation/devicetree/bindings/interrupt-controller/mstar,msc313-intc.yaml
```yaml
# SPDX-License-Identifier: (GPL-2.0 OR BSD-2-Clause)
# Copyright 2020 thingy.jp.
%YAML 1.2
---
$id: "http://devicetree.org/schemas/interrupt-controller/mstar,msc313-intc.yaml#"
$schema: "http://devicetree.org/meta-schemas/core.yaml#"

title: MStar/SigmaStar ARMv7 SoC Interrupt Controller Device Tree Bindings

maintainers:
  - Daniel Palmer <daniel@thingy.jp>

allOf:
  - $ref: /schemas/interrupt-controller.yaml#

properties:
  "#interrupt-cells":
    const: 2

  compatible:
    enum:
      - mstar,msc313-intc-irq
      - mstar,msc313-intc-fiq

  reg:
    maxItems: 1

  interrupt-controller: true

  mstar,gic-offset:
    description:
      Offset added to the intc irq number to get the parent GIC irq.
    allOf:
      - $ref: /schemas/types.yaml#/definitions/uint32
      - minimum: 0
        maximum: 255

  mstar,nr-interrupts:
    description:
      Number of interrupt lines this intc has.
    allOf:
      - $ref: /schemas/types.yaml#/definitions/uint32
      - minimum: 1
        maximum: 64

required:
  - "#interrupt-cells"
  - compatible
  - reg
  - interrupt-controller
  - mstar,gic-offset
  - mstar,nr-interrupts

additionalProperties: false

examples:
  - |
    intc_fiq: intc@201310 {
        compatible = "mstar,msc313-intc-fiq";
        interrupt-controller;
        reg = <0x201310 0x40>;
        #interrupt-cells = <2>;
        interrupt-parent = <&gic>;
        mstar,gic-offset = <96>;
        mstar,nr-interrupts = <32>;
    };

  - |
    intc_irq: intc@201350 {
        compatible = "mstar,msc313-intc-irq";
        interrupt-controller;
        reg = <0x201350 0x40>;
        #interrupt-cells = <2>;
        interrupt-parent = <&gic>;
        mstar,gic-offset = <32>;
        mstar,nr-interrupts = <64>;
    };

...
```

## Documentation/devicetree/bindings/m68k/cpus.yaml
```yaml
# SPDX-License-Identifier: (GPL-2.0-only OR BSD-2-Clause)
%YAML 1.2
---
$id: http://devicetree.org/schemas/mips/cpus.yaml#
$schema: http://devicetree.org/meta-schemas/core.yaml#

title: M68K CPUs

maintainers:
  - Daniel Palmer <daniel@thingy.jp>

description: |
  The device tree allows to describe the layout of CPUs in a system through
  the "cpus" node, which in turn contains a number of subnodes (ie "cpu")
  defining properties for every CPU.

properties:
  compatible:
    enum:
      - motorola,mc68000

  reg:
    maxItems: 1

  clocks:
    maxItems: 1

  device_type: true

required:
  - compatible
  - reg

additionalProperties: false

...
```

## Documentation/devicetree/bindings/rtc/mstar,msc313-rtc.yaml
```yaml
# SPDX-License-Identifier: GPL-2.0
%YAML 1.2
---
$id: http://devicetree.org/schemas/rtc/trivial-rtc.yaml#
$schema: http://devicetree.org/meta-schemas/core.yaml#

title: MStar/SigmaStar RTC

maintainers:
  - Daniel Palmer <daniel@thiny.jp>

description: |
  MStar RTC

allOf:
  - $ref: "rtc.yaml#"

properties:
  compatible:
    enum:
      - mstar,msc313-rtc

  reg:
    maxItems: 1

  interrupts:
    maxItems: 1

required:
  - compatible
  - reg

additionalProperties: false

...
```

## Documentation/devicetree/bindings/spi/litex,litespi.txt
```
LiteSPI controller

Required properties:
- compatible should be "litex,litespi"
- reg: base address and length of the register set for this device
- litespi,max-bpw: maximum value of bits per word
- litespi,sck-frequency: SPI clock frequency
- litespi,num-cs: number of chip select lines available

Example:

litespi0: spi@f0005800 {
	compatible = "litex,litespi";
	reg = <0xf0005800 0x100>;

	litespi,max-bpw = <8>;
	litespi,sck-frequency = <1000000>;
	litespi,num-cs = <2>;
};
```

## Documentation/devicetree/bindings/usb/faraday,fotg210.yaml
```yaml
# SPDX-License-Identifier: GPL-2.0
%YAML 1.2
---
$id: http://devicetree.org/schemas/usb/faraday,fotg210.yaml#
$schema: http://devicetree.org/meta-schemas/core.yaml#

title: Faraday FOTG Host controller

maintainers:
  - Daniel Palmer <daniel@thingy.jp>

allOf:
  - $ref: "usb-hcd.yaml"

properties:
  compatible:
    oneOf:
      - items:
          - const: "cortina,gemini-usb"
          - const: "faraday,fotg210"
      - items:
          - const: "mstar,msc313-ehci"
          - const: "faraday,fusbh200"
      - const: "faraday,fotg210"
      - const: "faraday,fusbh200"

  reg:
    maxItems: 1

  interrupts:
    maxItems: 1

  clocks:
    maxItems: 1

  clock-names:
    items:
      - const: PCLK

  resets:
    maxItems: 1

required:
  - compatible
  - reg
  - interrupts

additionalProperties: false

examples:
  - |
      #include <dt-bindings/interrupt-controller/irq.h>
      #include <dt-bindings/clock/cortina,gemini-clock.h>
      #include <dt-bindings/reset/cortina,gemini-reset.h>
      usb@68000000 {
        compatible = "cortina,gemini-usb", "faraday,fotg210";
        reg = <0x68000000 0x1000>;
        interrupts = <10 IRQ_TYPE_LEVEL_HIGH>;
        resets = <&syscon GEMINI_RESET_USB0>;
        clocks = <&syscon GEMINI_CLK_GATE_USB0>;
        clock-names = "PCLK";
      };

...
```
