// SPDX-License-Identifier: GPL-2.0
/*
 * Copyright (c) 2020 thingy.jp.
 * Author: Daniel Palmer <daniel@thingy.jp>
 */

#include "infinity6b0.dtsi"

/ {
	memory {
		device_type = "memory";
		reg = <0x20000000 0x8000000>;
	};
};
