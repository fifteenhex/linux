// SPDX-License-Identifier: GPL-2.0-or-later
/*
 * Copyright (c) 2020 thingy.jp.
 * Author: Daniel Palmer <daniel@thingy.jp>
 */

#include "infinity.dtsi"

&cpu0_opp_table {
	opp-1000000000 {
		opp-hz = /bits/ 64 <1000000000>;
		opp-microvolt = <1000000>;
		clock-latency-ns = <300000>;
	};

	/*
	// 100mhz overclock
	opp-1100000000 {
		opp-hz = /bits/ 64 <1100000000>;
		opp-microvolt = <1000000>;
		clock-latency-ns = <300000>;
	};*/
};

&imi {
	reg = <0xa0000000 0x20000>;
};

&phy {
	compatible = "ethernet-phy-idDEAD.B33F";
};
